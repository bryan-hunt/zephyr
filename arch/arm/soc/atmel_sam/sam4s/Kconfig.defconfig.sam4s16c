## arch/arm/soc/atmel_sam/sam4s/Kconfig.defconfig.sam4s16c
```kconfig
# Kconfig - Atmel SAM4S MCU series configuration options
#
# Copyright (c) 2017 Justin Watson
#
# SPDX-License-Identifier: Apache-2.0
#

if SOC_PART_NUMBER_ATSAM4S16C

config SOC
	string
	default atsam4s16c

#
# SAM4S family has total 35 peripherals capable of
# generating interrupts.
#
config NUM_IRQS
	int
	default 35

config SYS_CLOCK_HW_CYCLES_PER_SEC
	int
	default 120000000

endif # SOC_ATSAM4S16C
```

## arch/arm/soc/atmel_sam/sam4s/Kconfig.defconfig.sam4sd32c
```kconfig
# Kconfig - Atmel SAM4S MCU series configuration options
#
# Copyright (c) 2017 Microchip Technology Inc
#
# SPDX-License-Identifier: Apache-2.0
#

if SOC_PART_NUMBER_ATSAM4SD32C

config SOC
	string
	default atsam4sd32c

#
# SAM4S family has total 35 peripherals capable of
# generating interrupts.
#
config NUM_IRQS
	int
	default 35

endif # SOC_ATSAM4SD32C
```

## arch/arm/soc/atmel_sam/sam4s/Kconfig.defconfig.series
```kconfig
# Kconfig - Atmel SAM4S MCU series configuration options
#
# Copyright (c) 2017 Justin Watson
#
# SPDX-License-Identifier: Apache-2.0
#

if SOC_SERIES_SAM4S

source "arch/arm/soc/atmel_sam/sam4s/Kconfig.defconfig.sam4s*"

config SOC_SERIES
	string
	default sam4s

if GPIO

config GPIO_SAM
	def_bool y

endif #GPIO
	
if SPI

config SPI_SAM
	def_bool y
	
endif #SPI

if UART

config UART_SAM
	def_bool y

endif #SPI

if USART

config USART_SAM
	def_bool y

endif #USART

if I2C

config I2C_SAM_TWI
	def_bool y
	
endif #I2C

endif # SOC_SERIES_SAM4S
```

## arch/arm/soc/atmel_sam/samg/Kconfig.defconfig.series
```kconfig
# Kconfig - Atmel SAM4S MCU series configuration options
#
# Copyright (c) 2017 Justin Watson
#
# SPDX-License-Identifier: Apache-2.0
#

if SOC_SERIES_SAMG

source "arch/arm/soc/atmel_sam/samg/Kconfig.defconfig.samg*"

config SOC_SERIES
	string
	default samg

endif # SOC_SERIES_SAMG
```

## arch/arm/soc/atmel_sam/samg/Kconfig.series
```kconfig
# Kconfig - Atmel SAMG5 MCU series
#
# Copyright (c) 2017 Microchip Technology Inc
#
# SPDX-License-Identifier: Apache-2.0
#

config SOC_SERIES_SAMG
	bool "Atmel SAMG MCU"
	select CPU_CORTEX_M
	select CPU_CORTEX_M4
	select SOC_FAMILY_SAM
	select SYS_POWER_LOW_POWER_STATE_SUPPORTED
	select CPU_HAS_SYSTICK
	select ASF
	help
	  Enable support for Atmel SAMG Cortex-M4 microcontrollers.
```

## boards/arm/sam4s_xplained_pro/Kconfig
```kconfig
# Kconfig - Atmel SAM4S Xplained Board selection
#
# Copyright (c) 2017 Microchip Technology Inc
# SPDX-License-Identifier: Apache-2.0
#

choice
	optional
	prompt "Expansion Header 1 (EXT1)"
	config CRYPTOAUTH_EXT1
		bool "ATCRYPTOAUTH-XPRO"
	config WINC1500_EXT1
		bool "ATWINC1500-XPRO"
		select WIFI_WINC1500
	config ETHERNET_EXT1
		bool "ATETHERNET1-XPRO"
endchoice

choice
	optional
	prompt "Expansion Header 2 (EXT2)"
	config CRYPTOAUTH_EXT2
		bool "ATCRYPTOAUTH-XPRO"
	config ETHERNET_EXT2
		bool "ATETHERNET1-XPRO"
	config WINC1500_EXT2
		bool "ATWINC1500-XPRO"
		select WIFI_WINC1500
endchoice

choice
	optional
	prompt "Expansion Header 3 (EXT3)"
	config CRYPTOAUTH_EXT3
		bool "ATCRYPTOAUTH-XPRO"
	config ETHERNET_EXT3
		bool "ATETHERNET1-XPRO"
	config OLED1_EXT3
		bool "ATOLED1-XPRO"
	config WINC1500_EXT3
		bool "ATWINC1500-XPRO"
		select WIFI_WINC1500
endchoice

# In reality we should be able to support multiple boards and multiple
# devices but that adds quite a bit of complexity here right now

if CRYPTOAUTH_EXT1 || CRYPTOAUTH_EXT2 || CRYPTOAUTH_EXT3
	config CRYPTOAUTH_ATAES132A
		bool "ATAES132A"
		select CRYPTO_ATAES132A 
		help
			Depends on I2C & CRYPTO
	config CRYPTOAUTH_ATECC508A
		bool "ATECC508A"
		select CRYPTO_ATECC508A
	config CRYPTOAUTH_ATSHA204A
		bool "ATSHA204A"
		select CRYPTO_ATSHA204A
endif
```

## boards/arm/sam4s_xplained_pro/Kconfig.board
```kconfig
# Kconfig - Atmel SAM4S Xplained Board selection
#
# Copyright (c) 2017 Microchip Technology Inc
# SPDX-License-Identifier: Apache-2.0
#

config BOARD_SAM4S_XPLAINED_PRO
	bool "Atmel SAM4S Xplained Pro"
	depends on SOC_ATSAM4SD32C
```

## boards/arm/sam4s_xplained_pro/Kconfig.defconfig
```kconfig
# Kconfig - Atmel SAM4S Xplained pRO Board configuration
#
# Copyright (c) 2017 Microchip Technology Inc
# SPDX-License-Identifier: Apache-2.0
#

if BOARD_SAM4S_XPLAINED_PRO

config BOARD
	string
	default sam4s_xplained_pro

config SYS_CLOCK_HW_CYCLES_PER_SEC
	int
	default 120000000
	
endif # BOARD_SAM4S_XPLAINED_PRO
```

## boards/arm/samg55_xplained_pro/Kconfig.board
```kconfig
# Kconfig - Atmel SAMG55 Xplained Board selection
#
# Copyright (c) 2017 Microchip Technology Inc
# SPDX-License-Identifier: Apache-2.0
#

config BOARD_SAMG55_XPLAINED_PRO
	bool "Atmel SAMG55 Xplained Pro"
	depends on SOC_ATSAMG55J19
```

## boards/arm/samg55_xplained_pro/Kconfig.defconfig
```kconfig
# Kconfig - Atmel SAMG55 Xplained pRO Board configuration
#
# Copyright (c) 2017 Microchip Technology Inc
# SPDX-License-Identifier: Apache-2.0
#

if BOARD_SAMG55_XPLAINED_PRO

config BOARD
	string
	default samg55_xplained_pro

endif # BOARD_SAMG55_XPLAINED_PRO
```

## boards/arm/samg55_xplained_pro/samg55_xplained_pro_defconfig
```kconfig
CONFIG_ARM=y
CONFIG_SOC_FAMILY_SAM=y
CONFIG_SOC_SERIES_SAMG=y
CONFIG_SOC_ATSAMG55J19=y
CONFIG_CORTEX_M_SYSTICK=y
CONFIG_CONSOLE=y
CONFIG_UART_CONSOLE=y
CONFIG_SERIAL=y
CONFIG_USART_SAM=y
CONFIG_USART_SAM_PORT_1=y
CONFIG_BOARD_SAMG55_XPLAINED_PRO=y
CONFIG_SOC_ATMEL_SAM4S_EXT_MAINCK=y
```

## drivers/gpio/Kconfig.sam
```kconfig
# Kconfig.atmel_sam3 - Atmel SAM3 GPIO configuration options
#
#
# Copyright (c) 2016 Intel Corporation
#
# SPDX-License-Identifier: Apache-2.0
#

menuconfig GPIO_SAM
	bool "Atmel SAM PIO Controllers"
	depends on GPIO && SOC_FAMILY_SAM
	default n
	help
	  Enable config options to support the PIO controllers
	  on Atmel SAM family processors.

	  Says n if not sure.

if GPIO_SAM

config GPIO_SAM_PORTA
	bool "Enable driver for Atmel SAM3 PIO Port A"
	default n
	help
	  Build the driver to utilize PIO controller Port A.

config GPIO_SAM_PORTA_IRQ_PRI
	int "Interrupt Priority for Port A"
	depends on GPIO_SAM_PORTA
	default 3
	help
	  Interrupt priority for Port A.

config GPIO_SAM_PORTB
	bool "Enable driver for Atmel SAM PIO Port B"
	default n
	help
	  Build the driver to utilize PIO controller Port B.

config GPIO_SAM_PORTB_IRQ_PRI
	int "Interrupt Priority for Port B"
	depends on GPIO_SAM_PORTB
	default 3
	help
	  Interrupt priority for Port B.

config GPIO_SAM_PORTC
	bool "Enable driver for Atmel SAM PIO Port C"
	default n
	help
	  Build the driver to utilize PIO controller Port C.

config GPIO_SAM_PORTC_IRQ_PRI
	int "Interrupt Priority for Port C"
	depends on GPIO_SAM_PORTC
	default 3
	help
	  Interrupt priority for Port C.

config GPIO_SAM_PORTD
	bool "Enable driver for Atmel SAM PIO Port D"
	default n
	help
	  Build the driver to utilize PIO controller Port D.

config GPIO_SAM_PORTD_IRQ_PRI
	int "Interrupt Priority for Port D"
	depends on GPIO_SAM_PORTD
	default 3
	help
	  Interrupt priority for Port D.

endif # GPIO_SAM
```
